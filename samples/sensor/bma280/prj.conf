## CMakeLists.txt
```
# SPDX-License-Identifier: Apache-2.0

cmake_minimum_required(VERSION 3.13.1)
include($ENV{ZEPHYR_BASE}/cmake/app/boilerplate.cmake NO_POLICY_SCOPE)
project(bma280)

FILE(GLOB app_sources src/*.c)
target_sources(app PRIVATE ${app_sources})
```

## sample.yaml
```
sample:
  name: BMA280 Sensor sample
tests:
  sample.sensor.bma280:
    harness: console
    tags: sensors
    depends_on: i2c bma280
    harness_config:
        type: one_line
        regex:
            - "x: (.*); y: (.*); z: (.*)"
        fixture: fixture_i2c_bma280
  sample.sensor.bma280.spi:
    harness: console
    tags: sensors
    depends_on: spi bma280
    extra_args: "CONF_FILE=prj_spi.conf"
    harness_config:
        type: one_line
        regex:
            - "x: (.*); y: (.*); z: (.*)"
        fixture: fixture_spi_bme280
```

## prj.conf
```kconfig
CONFIG_STDOUT_CONSOLE=y
CONFIG_I2C=y
CONFIG_SENSOR=y
CONFIG_BMA280=y
```

## prj_spi.conf
```kconfig
CONFIG_STDOUT_CONSOLE=y
CONFIG_SPI=y
CONFIG_SENSOR=y
CONFIG_BMA280=y
```

## src/main.c
```c
/*
 * Copyright (c) 2019 Matthias Wauer
 *
 * SPDX-License-Identifier: Apache-2.0
 */

#include <zephyr.h>
#include <device.h>
#include <sensor.h>

void main(void)
{
	struct device *dev = device_get_binding(CONFIG_BMA280_NAME);

	if (dev == NULL) {
		printk("Could not get BMA280 device\n");
		return;
	}

	printk("dev %p name %s\n", dev, dev->config->name);

	while (1) {
		struct sensor_value accel_xyz[3];

		sensor_sample_fetch(dev);
		sensor_channel_get(dev, SENSOR_CHAN_ACCEL_XYZ, accel_xyz);
		/*sensor_channel_get(dev, SENSOR_CHAN_ACCEL_Y, &accel_y);
		sensor_channel_get(dev, SENSOR_CHAN_ACCEL_Z, &accel_z); */

		printk("x: %d.%06d; y: %d.%06d; z: %d.%06d\n",
		      accel_xyz[0].val1, accel_xyz[0].val2, accel_xyz[1].val1, accel_xyz[1].val2,
		      accel_xyz[2].val1, accel_xyz[2].val2);

		k_sleep(1000);
	}
}
```
