## boards/arm/calliope_mini/Kconfig.board
```kconfig
# Kconfig - nRF51 CALLIOPE_MINI board configuration
#
# Copyright (c) 2019 Matthias Wauer
#
# SPDX-License-Identifier: Apache-2.0

config BOARD_CALLIOPE_MINI
	bool "CALLIOPE MINI"
	depends on SOC_NRF51822_QFAA
```

## boards/arm/calliope_mini/Kconfig.defconfig
```kconfig
# Kconfig - nRF51 CALLIOPE_MINI board configuration
#
# Copyright (c) 2019 Matthias Wauer
#
# SPDX-License-Identifier: Apache-2.0

if BOARD_CALLIOPE_MINI

config BOARD
	default "calliope_mini"

if I2C

config I2C_0
	default y

endif # I2C

config BT_CTLR
	default BT

if BMA280
config BMA280_CHIP_BMC150_ACCEL
endif

endif # BOARD_CALLIOPE_MINI
```

## boards/arm/stm32f429i_disc1/Kconfig.defconfig
```kconfig
# STM32F4DISCOVERY board configuration

# Copyright (c) 2016 Linaro Limited.
# SPDX-License-Identifier: Apache-2.0

if BOARD_STM32F429I_DISC1

config BOARD
	default "stm32f429i_disc1"


if DISPLAY

config SPI
	default y

config ILI9340
	default y

if LVGL

config LVGL_DISPLAY_DEV_NAME
	default "DISPLAY"

endif # LVGL

endif # DISPLAY

endif # BOARD_STM32F429I_DISC1
```
